/ {
    chosen {
        zmk,underglow = &led_strip;
    };
};

&spi0 {
    compatible = "nordic,nrf-spim";
    status = "okay";

    led_strip: ws2812@0 {
        compatible = "worldsemi,ws2812-spi";
        label = "WS2812";

        /* SPI */
        reg = <0>;
        spi-max-frequency = <4000000>;

        /* WS2812 */
        chain-length = <76>; /* number of LEDs */
        color-mapping = <LED_COLOR_ID_GREEN LED_COLOR_ID_RED LED_COLOR_ID_BLUE>;
        spi-one-frame = <0x70>;
        spi-zero-frame = <0x40>;
    };
}; 